## esp-idf/main/nvs_components/Kconfig.projbuild
```kconfig
menu "NVS Module Info"

    choice 
        prompt "Select Module Type"
    
        config MODULE_TYPE_NODE
            bool "node"

        config MODULE_TYPE_CONTROLLER
            bool "controller"

    endchoice

    config MODULE_LOCATION
        string "Module Location"
        default "UNKNOWN"
        help
            Module location information

    config MODULE_IDENTITY
        int "Unique module identifier"
        default 0
        help
            add unique module identifier, consult config file for available unit numbers

    menu "Sensor List"
        
        config SENSOR_TEMP
            int "Temperature"
            default 0
            range 0 5

            menu "Temp Sensor Locations"
                
                config SENSOR_TEMP_1_LOCATION
                    string "Location of Temp Sensor 1"
                    default "Unknown"
                    depends on SENSOR_TEMP >= 1

                    config SENSOR_TEMP_1_PIN
                        int "Pin Number of Temp Sensor 1"
                        default 0
                        range 0 35
                        depends on SENSOR_TEMP >= 1

                
                config SENSOR_TEMP_2_LOCATION
                    string "Location of Temp Sensor 2"
                    default "Unknown"
                    depends on SENSOR_TEMP >= 2
                
                    config SENSOR_TEMP_2_PIN
                        int "Pin Number of Temp Sensor 2"
                        default 0
                        range 0 35
                        depends on SENSOR_TEMP >= 2

                config SENSOR_TEMP_3_LOCATION
                    string "Location of Temp Sensor 3"
                    default "Unknown"
                    depends on SENSOR_TEMP >= 3

                    config SENSOR_TEMP_3_PIN
                        int "Pin Number of Temp Sensor 3"
                        default 0
                        range 0 35
                        depends on SENSOR_TEMP >= 3

                config SENSOR_TEMP_4_LOCATION
                    string "Location of Temp Sensor 4"
                    default "Unknown"
                    depends on SENSOR_TEMP >= 4

                    config SENSOR_TEMP_4_PIN
                        int "Pin Number of Temp Sensor 4"
                        default 0
                        range 0 35
                        depends on SENSOR_TEMP >= 4

                config SENSOR_TEMP_5_LOCATION
                    string "Location of Temp Sensor 5"
                    default "Unknown"
                    depends on SENSOR_TEMP >= 5

                    config SENSOR_TEMP_5_PIN
                        int "Pin Number of Temp Sensor 5"
                        default 0
                        range 0 35
                        depends on SENSOR_TEMP >= 5

            endmenu
            
        config SENSOR_HUMIDITY
            int "Humidity"
            default 0
            range 0 5

            menu "Humidity Sensor Locations"
                
                config SENSOR_HUMIDITY_1_LOCATION
                    string "Location of Humidity Sensor 1"
                    default "Unknown"
                    depends on SENSOR_HUMIDITY >= 1

                    config SENSOR_HUMIDITY_1_PIN
                        int "Pin Number of Humidity Sensor 1"
                        default 0
                        range 0 35
                        depends on SENSOR_HUMIDITY >= 1
                
                config SENSOR_HUMIDITY_2_LOCATION
                    string "Location of Humidity Sensor 2"
                    default "Unknown"
                    depends on SENSOR_HUMIDITY >= 2

                    config SENSOR_HUMIDITY_2_PIN
                        int "Pin Number of Humidity Sensor 2"
                        default 0
                        range 0 35
                        depends on SENSOR_HUMIDITY >= 2
                
                config SENSOR_HUMIDITY_3_LOCATION
                    string "Location of Humidity Sensor 3"
                    default "Unknown"
                    depends on SENSOR_HUMIDITY >= 3

                    config SENSOR_HUMIDITY_3_PIN
                            int "Pin Number of Humidity Sensor 3"
                            default 0
                            range 0 35
                            depends on SENSOR_HUMIDITY >= 3

                config SENSOR_HUMIDITY_4_LOCATION
                    string "Location of Humidity Sensor 4"
                    default "Unknown"
                    depends on SENSOR_HUMIDITY >= 4

                    config SENSOR_HUMIDITY_4_PIN
                        int "Pin Number of Humidity Sensor 4"
                        default 0
                        range 0 35
                        depends on SENSOR_HUMIDITY >= 4

                config SENSOR_HUMIDITY_5_LOCATION
                    string "Location of Humidity Sensor 5"
                    default "Unknown"
                    depends on SENSOR_HUMIDITY >= 5

                    config SENSOR_HUMIDITY_5_PIN
                        int "Pin Number of Humidity Sensor 5"
                        default 0
                        range 0 35
                        depends on SENSOR_HUMIDITY >= 5

            endmenu

        config SENSOR_SOIL_MOISTURE
            int "Soil Moisture"
            default 0
            range 0 5

            menu "Soil Moisture Sensor Locations"
                
                config SENSOR_SOIL_MOISTURE_1_LOCATION
                    string "Location of Soil Moisture Sensor 1"
                    default "Unknown"
                    depends on SENSOR_SOIL_MOISTURE >= 1

                    config SENSOR_SOIL_MOISTURE_1_PIN
                        int "Pin Number of Soil Moisture Sensor 1"
                        default 0
                        range 0 35
                        depends on SENSOR_SOIL_MOISTURE >= 1

                config SENSOR_SOIL_MOISTURE_2_LOCATION
                    string "Location of Soil Moisture Sensor 2"
                    default "Unknown"
                    depends on SENSOR_SOIL_MOISTURE >= 2

                    config SENSOR_SOIL_MOISTURE_2_PIN
                        int "Pin Number of Soil Moisture Sensor 2"
                        default 0
                        range 0 35
                        depends on SENSOR_SOIL_MOISTURE >= 2
                
                config SENSOR_SOIL_MOISTURE_3_LOCATION
                    string "Location of Soil Moisture Sensor 3"
                    default "Unknown"
                    depends on SENSOR_SOIL_MOISTURE >= 3

                    config SENSOR_SOIL_MOISTURE_3_PIN
                        int "Pin Number of Soil Moisture Sensor 3"
                        default 0
                        range 0 35
                        depends on SENSOR_SOIL_MOISTURE >= 3

                config SENSOR_SOIL_MOISTURE_4_LOCATION
                    string "Location of Soil Moisture Sensor 4"
                    default "Unknown"
                    depends on SENSOR_SOIL_MOISTURE >= 4

                    config SENSOR_SOIL_MOISTURE_4_PIN
                        int "Pin Number of Soil Moisture Sensor 4"
                        default 0
                        range 0 35
                        depends on SENSOR_SOIL_MOISTURE >= 4

                config SENSOR_SOIL_MOISTURE_5_LOCATION
                    string "Location of Soil Moisture Sensor 5"
                    default "Unknown"
                    depends on SENSOR_SOIL_MOISTURE >= 5

                    config SENSOR_SOIL_MOISTURE_5_PIN
                        int "Pin Number of Soil Moisture Sensor 5"
                        default 0
                        range 0 35
                        depends on SENSOR_SOIL_MOISTURE >= 5

            endmenu

        config SENSOR_LIGHT
            int "Light"
            default 0
            range 0 5

            menu "Light Sensor Locations"
                
                config SENSOR_LIGHT_1_LOCATION
                    string "Location of Light Sensor 1"
                    default "Unknown"
                    depends on SENSOR_LIGHT >= 1

                    config SENSOR_LIGHT_1_PIN
                        int "Pin Number of LIGHT Sensor 1"
                        default 0
                        range 0 35
                        depends on SENSOR_LIGHT >= 1
                
                config SENSOR_LIGHT_2_LOCATION
                    string "Location of Light Sensor 2"
                    default "Unknown"
                    depends on SENSOR_LIGHT >= 2

                     config SENSOR_LIGHT_2_PIN
                        int "Pin Number of LIGHT Sensor 2"
                        default 0
                        range 0 35
                        depends on SENSOR_LIGHT >= 2
                
                config SENSOR_LIGHT_3_LOCATION
                    string "Location of Light Sensor 3"
                    default "Unknown"
                    depends on SENSOR_LIGHT >= 3

                     config SENSOR_LIGHT_3_PIN
                        int "Pin Number of LIGHT Sensor 3"
                        default 0
                        range 0 35
                        depends on SENSOR_LIGHT >= 3

                config SENSOR_LIGHT_4_LOCATION
                    string "Location of Light Sensor 4"
                    default "Unknown"
                    depends on SENSOR_LIGHT >= 4

                     config SENSOR_LIGHT_4_PIN
                        int "Pin Number of LIGHT Sensor 4"
                        default 0
                        range 0 35
                        depends on SENSOR_LIGHT >= 4

                config SENSOR_LIGHT_5_LOCATION
                    string "Location of Light Sensor 5"
                    default "Unknown"
                    depends on SENSOR_LIGHT >= 5

                     config SENSOR_LIGHT_5_PIN
                        int "Pin Number of LIGHT Sensor 5"
                        default 0
                        range 0 35
                        depends on SENSOR_LIGHT >= 5

            endmenu

        config SENSOR_SOUND
            int "Sound"
            default 0 
            range 0 5

            menu "Sound Sensor Locations"
                
                config SENSOR_SOUND_1_LOCATION
                    string "Location of SOUND Sensor 1"
                    default "Unknown"
                    depends on SENSOR_SOUND >= 1
                    
                     config SENSOR_SOUND_1_PIN
                        int "Pin Number of Sound Sensor 1"
                        default 0
                        range 0 35
                        depends on SENSOR_SOUND >= 1
                
                config SENSOR_SOUND_2_LOCATION
                    string "Location of SOUND Sensor 2"
                    default "Unknown"
                    depends on SENSOR_SOUND >= 2

                    config SENSOR_SOUND_2_PIN
                        int "Pin Number of Sound Sensor 2"
                        default 0
                        range 0 35
                        depends on SENSOR_SOUND >= 2
                
                config SENSOR_SOUND_3_LOCATION
                    string "Location of SOUND Sensor 3"
                    default "Unknown"
                    depends on SENSOR_SOUND >= 3

                    config SENSOR_SOUND_3_PIN
                        int "Pin Number of Sound Sensor 3"
                        default 0
                        range 0 35
                        depends on SENSOR_SOUND >= 3

                config SENSOR_SOUND_4_LOCATION
                    string "Location of SOUND Sensor 4"
                    default "Unknown"
                    depends on SENSOR_SOUND >= 4

                    config SENSOR_SOUND_4_PIN
                        int "Pin Number of Sound Sensor 4"
                        default 0
                        range 0 35
                        depends on SENSOR_SOUND >= 4

                config SENSOR_SOUND_5_LOCATION
                    string "Location of SOUND Sensor 5"
                    default "Unknown"
                    depends on SENSOR_SOUND >= 5

                    config SENSOR_SOUND_5_PIN
                        int "Pin Number of Sound Sensor 5"
                        default 0
                        range 0 35
                        depends on SENSOR_SOUND >= 5

            endmenu
        
        config SENSOR_MOVEMENT
            int "Movement"
            default 0
            range 0 5

            menu "Movement Sensor Locations"
                
                config SENSOR_MOVEMENT_1_LOCATION
                    string "Location of Movement Sensor 1"
                    default "Unknown"
                    depends on SENSOR_MOVEMENT >= 1

                    config SENSOR_MOVEMENT_1_PIN
                        int "Pin Number of Movement Sensor 1"
                        default 0
                        range 0 35
                        depends on SENSOR_MOVEMENT >= 1
                
                config SENSOR_MOVEMENT_2_LOCATION
                    string "Location of Movement Sensor 2"
                    default "Unknown"
                    depends on SENSOR_MOVEMENT >= 2

                    config SENSOR_MOVEMENT_2_PIN
                        int "Pin Number of Movement Sensor 2"
                        default 0
                        range 0 35
                        depends on SENSOR_MOVEMENT >= 2
                
                config SENSOR_MOVEMENT_3_LOCATION
                    string "Location of Movement Sensor 3"
                    default "Unknown"
                    depends on SENSOR_MOVEMENT >= 3

                    config SENSOR_MOVEMENT_3_PIN
                        int "Pin Number of Movement Sensor 3"
                        default 0
                        range 0 35
                        depends on SENSOR_MOVEMENT >= 3

                config SENSOR_MOVEMENT_4_LOCATION
                    string "Location of Movement Sensor 4"
                    default "Unknown"
                    depends on SENSOR_MOVEMENT >= 4

                    config SENSOR_MOVEMENT_4_PIN
                        int "Pin Number of Movement Sensor 4"
                        default 0
                        range 0 35
                        depends on SENSOR_MOVEMENT >= 4

                config SENSOR_MOVEMENT_5_LOCATION
                    string "Location of Movement Sensor 5"
                    default "Unknown"
                    depends on SENSOR_MOVEMENT >= 5

                    config SENSOR_MOVEMENT_5_PIN
                        int "Pin Number of Movement Sensor 5"
                        default 0
                        range 0 35
                        depends on SENSOR_MOVEMENT >= 5

            endmenu

        config SENSOR_CAMERA
            int "Camera"
            default 0 
            range 0 5

            menu "Camera Locations"
                
                config SENSOR_CAMERA_1_LOCATION
                    string "Location of Camera 1"
                    default "Unknown"
                    depends on SENSOR_CAMERA >= 1

                    config SENSOR_CAMERA_1_PIN
                        int "Pin Number of Camera 1"
                        default 0
                        range 0 35
                        depends on SENSOR_CAMERA >= 1
                
                config SENSOR_CAMERA_2_LOCATION
                    string "Location of Camera 2"
                    default "Unknown"
                    depends on SENSOR_CAMERA >= 2

                    config SENSOR_CAMERA_2_PIN
                        int "Pin Number of Camera 2"
                        default 0
                        range 0 35
                        depends on SENSOR_CAMERA >= 2
                
                config SENSOR_CAMERA_3_LOCATION
                    string "Location of Camera 3"
                    default "Unknown"
                    depends on SENSOR_CAMERA >= 3

                    config SENSOR_CAMERA_3_PIN
                        int "Pin Number of Camera 3"
                        default 0
                        range 0 35
                        depends on SENSOR_CAMERA >= 3

                config SENSOR_CAMERA_4_LOCATION
                    string "Location of Camera 4"
                    default "Unknown"
                    depends on SENSOR_CAMERA >= 4

                    config SENSOR_CAMERA_4_PIN
                        int "Pin Number of Camera 4"
                        default 0
                        range 0 35
                        depends on SENSOR_CAMERA >= 4

                config SENSOR_CAMERA_5_LOCATION
                    string "Location of Camera 5"
                    default "Unknown"
                    depends on SENSOR_CAMERA >= 5

                    config SENSOR_CAMERA_5_PIN
                        int "Pin Number of Camera 5"
                        default 0
                        range 0 35
                        depends on SENSOR_CAMERA >= 5

            endmenu

    endmenu

endmenu
```
